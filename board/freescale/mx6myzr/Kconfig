## board/freescale/mx6myzr/Kconfig
```kconfig
if TARGET_MX6MYZR

config SYS_BOARD
	default "mx6myzr"

config SYS_VENDOR
	default "freescale"

config SYS_SOC
	default "mx6"

config SYS_CONFIG_NAME
	default "mx6myzr"

endif
```
